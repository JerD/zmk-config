## config/boards/shields/cornedongle/Kconfig.defconfig
```kconfig
if SHIELD_CORNEDONGLE_LEFT

config ZMK_KEYBOARD_NAME
    default "CorneDongle"

config ZMK_SPLIT_ROLE_CENTRAL
    default y

endif

if SHIELD_CORNEDONGLE_LEFT || SHIELD_CORNEDONGLE_RIGHT

config ZMK_SPLIT
    default y

endif
```

## config/boards/shields/cornedongle/Kconfig.shield
```kconfig
# Copyright (c) 2020 Pete Johanson
# SPDX-License-Identifier: MIT

config SHIELD_CORNEDONGLE_LEFT
    def_bool $(shields_list_contains,cornedongle_left)

config SHIELD_CORNEDONGLE_RIGHT
    def_bool $(shields_list_contains,cornedongle_right)
```

## config/boards/shields/trackball_test/Kconfig.defconfig
```kconfig
#if SHIELD_TRACKBALL_TEST

config ZMK_KEYBOARD_NAME
    default "trackball_test"

#endif

config SPI
	default y
```

## config/west.yml
```yaml
manifest:
  remotes:
    - name: zmkfirmware
      url-base: https://github.com/zmkfirmware
    # Alt sources
    # - name: sadekbaroudi
    #   url-base: https://github.com/sadekbaroudi
    # - name: petejohanson
    #   url-base: https://github.com/petejohanson
  projects:
    # Default source
    - name: zmk
      remote: zmkfirmware
      revision: main
      import: app/west.yml
    # This is a fork of zmk which includes mouse input, it can be removed once it has been merged to zmk
    # - name: zmk
    #   remote: petejohanson
    #   revision: feat/pointers-move-scroll
    #   import: app/west.yml
    # This is the fingerpunch ZMK source, use this for potential trackball stuff
    # - name: zmk-fingerpunch-controllers
    #   remote: sadekbaroudi
    #   revision: main
    #   import: config/deps.yml
  self:
    path: config
```
