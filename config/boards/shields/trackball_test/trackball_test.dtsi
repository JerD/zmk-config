#include <dt-bindings/zmk/matrix_transform.h>

/ {
    chosen {
        zmk,kscan = &kscan0;
    };

    default_transform: keymap_transform_0 {
        compatible = "zmk,matrix-transform";
        columns = <1>;
        rows = <1>;
        map = <
            RC(0,0)
        >;
    };


    
     kscan0: kscan_direct {
        compatible = "zmk,kscan-gpio-direct";
        wakeup-source;
        input-gpios = 
            <&gpio0 6 (GPIO_ACTIVE_LOW | GPIO_PULL_UP)>;
        debounce-press-ms = <5>;
        debounce-release-ms = <5>;
    };

    // TODO: per-key RGB node(s)?
};

