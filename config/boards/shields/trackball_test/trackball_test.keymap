#include <behaviors.dtsi>
#include <dt-bindings/zmk/bt.h>
#include <dt-bindings/zmk/keys.h>
#include <dt-bindings/zmk/outputs.h>


#define DEF 0

/ {
        keymap {
                compatible = "zmk,keymap";
                DEF_layer {

                      bindings = <
                            &kp Q
                        >;
                };
       };
};
